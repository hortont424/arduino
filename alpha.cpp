#include "WProgram.h"
#include <SPI.h>

#define DATAOUT 11 // MOSI
#define DATAIN 12 // MISO
#define SPICLOCK 13 // SCLK
#define SLAVESELECT 10 // CS

char color_buffer[64];

unsigned char space[8] = {0x00, 0x00, 0x00, 0x00, 0x00, 0x00, 0x00, 0x00};

unsigned char uppercase[26][8] = {
    {0x38, 0x44, 0x44, 0x7C, 0x44, 0x44, 0x44, 0x00},
    {0x78, 0x44, 0x44, 0x78, 0x44, 0x44, 0x78, 0x00},
    {0x38, 0x44, 0x40, 0x40, 0x40, 0x44, 0x38, 0x00},
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    {0x7C, 0x04, 0x08, 0x10, 0x20, 0x40, 0x7C, 0x00}
};

void setup()
{
    // SPI Bus setup
    SPI.begin();
    SPI.setClockDivider(2);

    // Set the pin modes for the RGB matrix
    pinMode(DATAOUT, OUTPUT);
    pinMode(DATAIN, INPUT);
    pinMode(SPICLOCK,OUTPUT);
    pinMode(SLAVESELECT,OUTPUT);

    // Make sure the RGB matrix is deactivated
    digitalWrite(SLAVESELECT,HIGH);

    delay(100);

    digitalWrite(SLAVESELECT, LOW);
    delay(10);
    SPI.transfer('%');
    SPI.transfer(1);
    delay(10);
    digitalWrite(SLAVESELECT, HIGH);
}

unsigned char * getCharacter(unsigned char c)
{
    if(c == ' ')
        return space;
    else
        return uppercase[c - 'A'];
}

unsigned char characterNumber = 0;
char * str = "HELLOMATTMAP";
unsigned char initialShift = 0;

void loop()
{
    while(1)
    {
        unsigned char aid = str[characterNumber] - 'A';
        unsigned char bid = str[characterNumber + 1] - 'A';

        for(int i = 0; i < 8; i++)
        {
            unsigned char av = uppercase[aid][i] << initialShift;
            unsigned char bv = uppercase[bid][i] >> (8 - initialShift);

            for(int j = 0; j < 8; j++)
            {
                color_buffer[(8 * i) + j] = ((av & 0x01) * 0xE0) + ((bv & 0x01) * 0x0F);
                av >>= 1;
                bv >>= 1;
            }
        }

        if(++initialShift > 7)
        {
            if(++characterNumber > strlen(str) - 2)
            {
                characterNumber = 0;
            }

            initialShift = 0;
        }

        digitalWrite(SLAVESELECT, LOW);
        for(int LED=0; LED<64; LED++)
            SPI.transfer(color_buffer[LED]);
        digitalWrite(SLAVESELECT, HIGH);

        delay(100);
    }
}