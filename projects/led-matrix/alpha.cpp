// NEEDS SPI

#include "WProgram.h"
#include <SPI.h>

#define DATAOUT 11 // MOSI
#define DATAIN 12 // MISO
#define SPICLOCK 13 // SCLK
#define SLAVESELECT 10 // CS

char color_buffer[64];

static unsigned char uppercase[][8] = {
    {0x00, 0x00, 0x00, 0x00, 0x00, 0x00, 0x00, 0x00},
    {0x00, 0x00, 0x00, 0x00, 0x00, 0x00, 0x00, 0x00},
    {0x00, 0x00, 0x00, 0x00, 0x00, 0x00, 0x00, 0x00},
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    {0x7C, 0x04, 0x08, 0x10, 0x20, 0x40, 0x7C, 0x00}  // Z == 90
};

void setup()
{
    // SPI Bus setup
    SPI.begin();
    SPI.setClockDivider(2);

    // Set the pin modes for the RGB matrix
    pinMode(DATAOUT, OUTPUT);
    pinMode(DATAIN, INPUT);
    pinMode(SPICLOCK,OUTPUT);
    pinMode(SLAVESELECT,OUTPUT);

    // Make sure the RGB matrix is deactivated
    digitalWrite(SLAVESELECT,HIGH);

    delay(100);

    digitalWrite(SLAVESELECT, LOW);
    delay(10);
    SPI.transfer('%');
    SPI.transfer(1);
    delay(10);
    digitalWrite(SLAVESELECT, HIGH);
}

unsigned char * getCharacter(unsigned char c)
{
    return uppercase[c];
}

unsigned char characterNumber = 0;
char * str = "LIGHTS CAMERA ACTION";
unsigned char initialShift = 0;

void loop()
{
    while(1)
    {
        unsigned char * aid = getCharacter(str[characterNumber]);
        unsigned char * bid = getCharacter(str[characterNumber + 1]);

        for(int i = 0; i < 8; i++)
        {
            unsigned char av = aid[i] << initialShift;
            unsigned char bv = bid[i] >> (8 - initialShift);

            for(int j = 0; j < 8; j++)
            {
                color_buffer[(8 * i) + j] = ((av & 0x01) * 0xE0) + ((bv & 0x01) * 0x0F);

                av >>= 1;
                bv >>= 1;
            }
        }

        if(++initialShift > 7)
        {
            if(++characterNumber > strlen(str) - 2)
            {
                characterNumber = 0;
            }

            initialShift = 0;
        }

        digitalWrite(SLAVESELECT, LOW);
        for(int LED=0; LED<64; LED++)
            SPI.transfer(color_buffer[LED]);
        digitalWrite(SLAVESELECT, HIGH);

        delay(60);
    }
}